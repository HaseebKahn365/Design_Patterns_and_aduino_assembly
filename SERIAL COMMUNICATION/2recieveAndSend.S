/*
program to send YES to pc screen
recieve data from porta switches and send it to pc screen
recieve data from pc and put it on portb leds
*/

#INCLUDE "M32DEF.INC"

//PORT A AS INPUT AND B AS OUTPUT

    LDI R16, 0XFF
    OUT DDRA, R16
    LDI R16, 0X00
    OUT PORTB, R16

//INIT THE STACK POINTER
    LDI R16, HIGH(RAMEND)
    LDI R17, LOW(RAMEND)
    OUT SPH, R16
    OUT SPL, R17

//INIT USART FOR 9600 BAUD RATE AND 8 BIT NO PARTIY AND 1 STOP BIT
    LDI R16, (1<<RXEN) | (1<<TXEN) //it will set the ucsrb register for recieve and transmit
    OUT UCSRB, R16

    LDI R16, (1<<URSEL) | (1<<UCSZ1) | (1<<UCSZ0) //it will set the ucsz1 and ucsz0 bits in ucsrb register
    OUT UCSRC, R16

    //SETTING BAUD RATE
    LDI R16, 0X33
    OUT UBBRRL, R16 //NO NEED OF UBRRH AS WE ARE USING 9600 BAUD RATE

//SENDING YES TO PC
    LDI R21, 'Y'
    CALL SEND
    LDI R21, 'E'
    CALL SEND
    LDI R21, 'S'
    CALL SEND
    
//CONSTANTLY SEND TO PC AFTER RECIEVE IS COMPLETE
LOOP:
    SBIS USCRA, RXC //SKIP ONLY IF THE RXC BIT IS SET IE. UDR IS EMPTY
    RJMP SKIP_RX
    
    THE FOLLOWING CODE SENDS DATA IF THE RECIEVE IS COMPLETE AND UDR IS EMPTY
    IN R17, UDR //I SEND THE DATA FROM UDR TO PORTB
    OUT PORTB, R17

//CONTROL IS HERE IF ONLY RECIEVE IS INCOMPLETE FROM PC TO PORTB
SKIP_RX:
    SBIS USCRA, UDRE 
    RJMP SKIP_TX
    //SEND THE DATA TO PC FROM PINA IF UDR IS EMPTY
    IN R17, PINA

//CONTROL IS HERE IF ONLY SEND IS INCOMPLETE FROM PORTA TO PC
SKIP_TX:
    RJMP LOOP



//DEFINITON OF SEND 

SEND: 
    SBIS USCRA, UDRE
    RJMP SEND //IF NOT EMPTY THEN WAIT
    OUT UDR, R21 //IF EMPTY THEN SEND THE DATA
    RET

